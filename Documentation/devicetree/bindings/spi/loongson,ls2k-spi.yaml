## Documentation/devicetree/bindings/spi/loongson,ls2k-spi.yaml
```yaml
# SPDX-License-Identifier: (GPL-2.0 OR BSD-2-Clause)
%YAML 1.2
---
$id: http://devicetree.org/schemas/spi/loongson,ls2k-spi.yaml#
$schema: http://devicetree.org/meta-schemas/core.yaml#

title: Loongson SPI controller

maintainers:
  - Yinbo Zhu <zhuyinbo@loongson.cn>

allOf:
  - $ref: /schemas/spi/spi-controller.yaml#

properties:
  compatible:
    oneOf:
      - enum:
          - loongson,ls2k0300-spi-io
          - loongson,ls2k1000-spi
      - items:
          - enum:
              - loongson,ls2k0300-spi-flash
              - loongson,ls2k0500-spi
          - const: loongson,ls2k1000-spi

  reg:
    maxItems: 1

  clocks:
    maxItems: 1

  interrupts:
    maxItems: 1

  dmas:
    maxItems: 2

  dma-names:
    items:
      - const: tx
      - const: rx

required:
  - compatible
  - reg
  - clocks

unevaluatedProperties: false

if:
  properties:
    compatible:
      contains:
        const: loongson,ls2k0300-spi-io

then:
  required:
    - dmas
    - dma-names
    - interrupts

else:
  properties:
    dmas: false
    dma-names: false

examples:
  - |
    spi0: spi@1fff0220{
        compatible = "loongson,ls2k1000-spi";
        reg = <0x1fff0220 0x10>;
        clocks = <&clk 17>;
        #address-cells = <1>;
        #size-cells = <0>;
    };

  - |
    #include <dt-bindings/interrupt-controller/irq.h>
    #include <dt-bindings/clock/loongson,ls2k-clk.h>

    spi@1610c000 {
        compatible = "loongson,ls2k0300-spi-io";
        reg = <0x1610c000 0x2000>;
        clocks = <&clk LS2K0300_CLK_DEV_GATE>;
        interrupt-parent = <&liointc0>;
        interrupts = <6 IRQ_TYPE_LEVEL_HIGH>;
        dmas =  <&dma 1 0x8e>, <&dma 0 0x8e>;
        dma-names = "tx", "rx";
    };
```
