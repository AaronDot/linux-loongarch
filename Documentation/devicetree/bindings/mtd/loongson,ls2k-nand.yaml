## Documentation/devicetree/bindings/mtd/loongson,ls2k-nand.yaml
```yaml
# SPDX-License-Identifier: (GPL-2.0-only OR BSD-2-Clause)
%YAML 1.2
---
$id: http://devicetree.org/schemas/mtd/loongson,ls2k-nand.yaml#
$schema: http://devicetree.org/meta-schemas/core.yaml#

title: Loongson-2K Nand Controller

maintainers:
  - Binbin Zhou <zhoubinbin@loongson.cn>

allOf:
  - $ref: nand-controller.yaml#

properties:
  compatible:
    const: loongson,ls2k1000-nand

  reg:
    maxItems: 1

  interrupts:
    maxItems: 1

  partitions:
    type: object
    deprecated: true
    description:
      Node containing description of fixed partitions.

required:
  - compatible
  - reg
  - interrupts

unevaluatedProperties: false

examples:
  - |
    nand-controller@1fe26040 {
        compatible = "loongson,ls-nand";
        reg = <0 0x1fe26040 0 0x0>,
              <0 0x1fe26000 0 0x20>;
        loongson,apbdma-conf = <&apbdma_conf 0x7 0>; /* Configure routing to dma0. */
        dmas = <&apbdma0 0>;
        dma-names = "nand_rw";

        partitions {
            #address-cells = <2>;
            #size-cells = <2>;
            compatible = "fixed-partitions";
            partition@0 {
                label = "kernel_partition";
                reg = <0 0x0000000 0 0x01400000>;
            };
            partition@1400000 {
                label = "os_partition";
                reg = <0 0x01400000 0 0x0>;
            };
        };
    };
```
